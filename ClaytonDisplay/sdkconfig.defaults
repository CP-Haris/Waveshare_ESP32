## ClaytonDisplay/sdkconfig.defaults
```kconfig
# ESP32-S3 Target
CONFIG_IDF_TARGET="esp32s3"
CONFIG_ESP_DEFAULT_CPU_FREQ_MHZ_240=y
CONFIG_ESPTOOLPY_FLASHMODE_QIO=y
CONFIG_ESPTOOLPY_FLASHFREQ_120M=y
CONFIG_ESPTOOLPY_FLASHSIZE_16MB=y
CONFIG_SPI_FLASH_HPM_ENA=y
CONFIG_SPI_FLASH_HPM_DC_AUTO=y
CONFIG_BOOTLOADER_FLASH_DC_AWARE=y
CONFIG_PARTITION_TABLE_CUSTOM=y
CONFIG_PARTITION_TABLE_CUSTOM_FILENAME="partitions.csv"
CONFIG_SPIRAM=y
CONFIG_SPIRAM_MODE_OCT=y
CONFIG_IDF_EXPERIMENTAL_FEATURES=y
CONFIG_SPIRAM_SPEED_120M=y
CONFIG_SPIRAM_FETCH_INSTRUCTIONS=y
CONFIG_SPIRAM_RODATA=y
CONFIG_FREERTOS_HZ=1000
CONFIG_ESP32S3_DATA_CACHE_LINE_64B=y
CONFIG_ESP32S3_DATA_CACHE_LINE_SIZE=64
CONFIG_COMPILER_OPTIMIZATION_PERF=y

CONFIG_ESP_CONSOLE_USB_SERIAL_JTAG=y

# Power management (needed for CPU clock scaling during display sleep)
CONFIG_PM_ENABLE=y
CONFIG_FREERTOS_USE_TICKLESS_IDLE=y

# LVGL task on core 1
CONFIG_EXAMPLE_LVGL_PORT_TASK_CORE=1
CONFIG_EXAMPLE_LVGL_PORT_AVOID_TEAR_ENABLE=y

# LVGL configuration
CONFIG_LV_MEM_CUSTOM=y
CONFIG_LV_MEMCPY_MEMSET_STD=y
CONFIG_LV_USE_LOG=y
CONFIG_LV_LOG_PRINTF=y
# CONFIG_LV_USE_PERF_MONITOR is not set
CONFIG_LV_ATTRIBUTE_FAST_MEM_USE_IRAM=y

# Fonts needed for the HMI
CONFIG_LV_FONT_MONTSERRAT_10=y
CONFIG_LV_FONT_MONTSERRAT_12=y
CONFIG_LV_FONT_MONTSERRAT_14=y
CONFIG_LV_FONT_MONTSERRAT_16=y
CONFIG_LV_FONT_MONTSERRAT_20=y
CONFIG_LV_FONT_MONTSERRAT_24=y
CONFIG_LV_FONT_MONTSERRAT_28=y
CONFIG_LV_FONT_MONTSERRAT_48=y
CONFIG_LV_USE_FONT_COMPRESSED=y
CONFIG_LV_USE_IMGFONT=y

# Demos (optional, for testing)
CONFIG_LV_USE_DEMO_WIDGETS=y

# Suppress legacy TWAI driver deprecation warning (using legacy API)
CONFIG_TWAI_SUPPRESS_DEPRECATE_WARN=y

# BLE (NimBLE stack for CAN gateway)
CONFIG_BT_ENABLED=y
CONFIG_BT_NIMBLE_ENABLED=y
CONFIG_BT_NIMBLE_MAX_CONNECTIONS=1
CONFIG_BT_NIMBLE_ROLE_CENTRAL=n
CONFIG_BT_NIMBLE_ROLE_OBSERVER=n
CONFIG_BT_NIMBLE_ROLE_BROADCASTER=y
CONFIG_BT_NIMBLE_ROLE_PERIPHERAL=y
CONFIG_BT_NIMBLE_NVS_PERSIST=y
CONFIG_BT_NIMBLE_SM_LEGACY=y
CONFIG_BT_NIMBLE_SM_SC=y
CONFIG_BT_NIMBLE_HANDLE_REPEAT_PAIRING_DELETION=y

# CAN/TWAI GPIO pins for ESP32-S3-Touch-LCD-5
CONFIG_EXAMPLE_TX_GPIO_NUM=15
CONFIG_EXAMPLE_RX_GPIO_NUM=16
CONFIG_LV_USE_DEMO_BENCHMARK=y
CONFIG_LV_USE_DEMO_STRESS=y
CONFIG_LV_USE_DEMO_MUSIC=y
CONFIG_LV_DEMO_MUSIC_AUTO_PLAY=y
```
